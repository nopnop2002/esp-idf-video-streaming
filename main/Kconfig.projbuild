## main/Kconfig.projbuild
```kconfig
menu "Application Configuration"

	config ESP_WIFI_SSID
		string "WiFi SSID"
		default "myssid"
		help
			SSID (network name) to connect to.

	config ESP_WIFI_PASSWORD
		string "WiFi Password"
		default "mypassword"
		help
			WiFi password (WPA or WPA2) to use.

	config ESP_MAXIMUM_RETRY
		int "Maximum retry"
		default 5
		help
			Set the Maximum retry to avoid station reconnecting to the AP unlimited when the AP is really inexistent.

	config MDNS_HOSTNAME
		string "mDNS Hostname"
		default "esp-cam"
		help
			mDNS Hostname to use

	config MANUAL_SETTING
		bool "Manual Setting"
		default n
		help
			Enable Manual Setting.

	choice FRAME_SIZE
		depends on MANUAL_SETTING
		prompt "Select Frame Size"
		default SIZE_320x240
		help
			Select Frame Size.
		config SIZE_640x480
			bool "640x480"
			help
				640x480.
		config SIZE_352x288
			bool "352x288"
			help
				352x288.
		config SIZE_320x240
			bool "320x240"
			help
				320x640.
		config SIZE_160x120
			bool "160x120"
			help
				160x120.
	endchoice

	config FRAME_RATE
		depends on SIZE_640x480
		int "Frame Rate"
		range 0 15
		default 15
		help
			Set the Frame Rate.

	config FRAME_RATE
		depends on SIZE_352x288 || SIZE_320x240 || SIZE_160x120
		int "Frame Rate"
		range 0 30
		default 30
		help
			Set the Frame Rate.

endmenu
```

## sdkconfig.defaults
```kconfig
#
# SPIRAM
#
CONFIG_SPIRAM=y
CONFIG_SPIRAM_MALLOC_RESERVE_INTERNAL=150000
CONFIG_SPIRAM_TRY_ALLOCATE_WIFI_LWIP=y
CONFIG_SPIRAM_SPEED_80M=y

#
# USB
#
CONFIG_USB_HOST_CONTROL_TRANSFER_MAX_SIZE=3000
CONFIG_USB_HOST_HW_BUFFER_BIAS_IN=y

#
# WIFI
#
CONFIG_ESP32_WIFI_STATIC_RX_BUFFER_NUM=8
CONFIG_ESP32_WIFI_DYNAMIC_RX_BUFFER_NUM=8
CONFIG_ESP32_WIFI_STATIC_TX_BUFFER_NUM=8
CONFIG_ESP32_WIFI_CACHE_TX_BUFFER_NUM=16
CONFIG_ESP32_WIFI_RX_BA_WIN=8

#
# LWIP
#
CONFIG_LWIP_TCP_SND_BUF_DEFAULT=15000

#
# ESP32S2-specific
#
CONFIG_ESP32S2_DEFAULT_CPU_FREQ_240=y
CONFIG_ESP32S2_DEFAULT_CPU_FREQ_MHZ=240

#
# ESP32S3-specific
#
CONFIG_ESP32S3_DEFAULT_CPU_FREQ_240=y
CONFIG_ESP32S3_DEFAULT_CPU_FREQ_MHZ=240
```
